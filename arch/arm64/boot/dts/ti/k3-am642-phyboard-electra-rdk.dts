// SPDX-License-Identifier: GPL-2.0
/*
 * Copyright (C) 2021 PHYTEC America, LLC - https://www.phytec.com
 * Author: Matt McKee <mmckee@phytec.com>
 */

/dts-v1/;

#include "k3-am642.dtsi"
#include "k3-am64-phycore-som.dtsi"
#include "k3-am64-phyboard-electra.dtsi"

/ {
	model = "PHYTEC phyBOARD-Electra-AM642";
	compatible = "phytec,am642-phyboard-electra",
		     "phytec,am64-phycore-som", "ti,am642";
};

